## components/osdp/Kconfig.projbuild
```kconfig
# put here your custom config value
menu "OSDP component config"

config OSDP_ENABLED
    bool "Использовать OSDP в режиме PK"
    default True
    help
        Включить если нужно OSDP

choice
    prompt "OSDP base UART baudrate"
    default UART_BAUDRATE_115200a
    help
      Select the baudrate for the UART interface.

config UART_BAUDRATE_9600
    bool "9600"

config UART_BAUDRATE_19200
    bool "19200"

config UART_BAUDRATE_38400
    bool "38400"

config UART_BAUDRATE_57600
    bool "57600"

config UART_BAUDRATE_115200
    bool "115200"

endchoice


config UART_BAUDRATE
    int
    default 9600    if UART_BAUDRATE_9600
    default 19200   if UART_BAUDRATE_19200
    default 38400   if UART_BAUDRATE_38400
    default 57600   if UART_BAUDRATE_57600
    default 115200  if UART_BAUDRATE_115200
    help
      Actual numeric baudrate value for use in code.

endmenu
```

## components/wiegand/Kconfig.projbuild
```kconfig
menu "Wiegand IO config"

# ---------------- WG1 ----------------
choice
    prompt "Режим работы 1 WG интерфейса"
    default WIEGAND_1_MODE_OUT
    help
        Выберите режим работы для 1-го интерфейса Wiegand (IN или OUT).

config WIEGAND_1_MODE_IN
    bool "IN"

config WIEGAND_1_MODE_OUT
    bool "OUT"

endchoice

config WIEGAND_1_MODE
    string
    default "IN"  if WIEGAND_1_MODE_IN
    default "OUT" if WIEGAND_1_MODE_OUT


# ---------------- WG2 ----------------
choice
    prompt "Режим работы 2 WG интерфейса"
    default WIEGAND_2_MODE_OUT
    help
        Выберите режим работы для 2-го интерфейса Wiegand (IN или OUT).

config WIEGAND_2_MODE_IN
    bool "IN"

config WIEGAND_2_MODE_OUT
    bool "OUT"

endchoice

config WIEGAND_2_MODE
    string
    default "IN"  if WIEGAND_2_MODE_IN
    default "OUT" if WIEGAND_2_MODE_OUT


# ---------------- WG3 ----------------
choice
    prompt "Режим работы 3 WG интерфейса"
    default WIEGAND_3_MODE_OUT
    help
        Выберите режим работы для 3-го интерфейса Wiegand (IN или OUT).

config WIEGAND_3_MODE_IN
    bool "IN"

config WIEGAND_3_MODE_OUT
    bool "OUT"

endchoice

config WIEGAND_3_MODE
    string
    default "IN"  if WIEGAND_3_MODE_IN
    default "OUT" if WIEGAND_3_MODE_OUT


# ---------------- WG4 ----------------
choice
    prompt "Режим работы 4 WG интерфейса"
    default WIEGAND_4_MODE_OUT
    help
        Выберите режим работы для 4-го интерфейса Wiegand (IN или OUT).

config WIEGAND_4_MODE_IN
    bool "IN"

config WIEGAND_4_MODE_OUT
    bool "OUT"

endchoice

config WIEGAND_4_MODE
    string
    default "IN"  if WIEGAND_4_MODE_IN
    default "OUT" if WIEGAND_4_MODE_OUT

endmenu
```
